/ {
	chosen {
		zephyr,console = &usart2;
		zephyr,shell-uart = &usart2;
	};
};

&usart2 {
	pinctrl-0 = <&usart2_tx_pd5 &usart2_rx_pd6>;
	pinctrl-names = "default";
	current-speed = <115200>;
	status = "okay";
};