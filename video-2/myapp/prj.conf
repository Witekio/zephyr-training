## CMakeLists.txt
```
cmake_minimum_required(VERSION 3.13.1)
find_package(Zephyr REQUIRED HINTS $ENV{ZEPHYR_BASE})

project(myapp LANGUAGES C)

target_sources(app PRIVATE src/main.c)
```

## prj.conf
```kconfig
CONFIG_MYLIB=y
```

## src/main.c
```c
#include <stdio.h>
#include <zephyr/kernel.h>
#include <zephyr/app_version.h>
#include <lib/mylib.h>

#define SLEEP_TIME_MS   1000

int main(void)
{
	int i = 0;
	char str[128];

	while (1) {
		printf("Hello Witekio ! " APP_VERSION_STRING "\r\n");
		mylib_get_val(str, i);
		printf("Cumputing %s\r\n", str);

		i = (i + 1)%60;

		k_msleep(SLEEP_TIME_MS/4);
	}
	return 0;
}
```
